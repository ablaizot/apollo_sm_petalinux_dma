## sm_2023_2/project-spec/configs/rootfsconfigs/Kconfig.user
```kconfig
menu "user packages " 
config dma-proxy  
	 bool "dma-proxy"
	 help
	
config dmatest  
	 bool "dmatest"
	 help
	
config gpio-demo  
	 bool "gpio-demo"
	 help
	
config peekpoke  
	 bool "peekpoke"
	 help
	
endmenu
```
